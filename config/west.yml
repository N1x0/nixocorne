## config/west.yml
```yaml
manifest:
  remotes:
    - name: zmkfirmware
      url-base: https://github.com/zmkfirmware
    - name: urob
      url-base: https://github.com/urob
  projects:
  
    # eyelash custom stuff
    - name: eyelash_corne
      url: https://github.com/a741725193/zmk-new_corne
      revision: main

      # base zmk
    - name: zmk
      remote: zmkfirmware
      revision: main
      import: app/west.yml

      
    - name: zmk-auto-layer
      remote: urob
      revision: main # set to same version as zmk
  self:
    path: config
```
